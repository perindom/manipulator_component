/**
 * @cliArgs --board "/ti/boards/CC3220SF_LAUNCHXL" --product "simplelink_cc32xx_sdk@4_20_00_07"
 * @versions {"tool":"1.9.0+2015","templates":null}
 */

/**
 * Import the modules used in this configuration.
 */
const GPIO   = scripting.addModule("/ti/drivers/GPIO", {}, false);
const GPIO1  = GPIO.addInstance();
const GPIO2  = GPIO.addInstance();
const GPIO3  = GPIO.addInstance();
const GPIO4  = GPIO.addInstance();
const GPIO5  = GPIO.addInstance();
const GPIO6  = GPIO.addInstance();
const GPIO7  = GPIO.addInstance();
const GPIO8  = GPIO.addInstance();
const GPIO9  = GPIO.addInstance();
const GPIO10 = GPIO.addInstance();
const GPIO11 = GPIO.addInstance();
const GPIO12 = GPIO.addInstance();
const GPIO13 = GPIO.addInstance();
const GPIO14 = GPIO.addInstance();
const PWM    = scripting.addModule("/ti/drivers/PWM");
const PWM1   = PWM.addInstance();
const PWM2   = PWM.addInstance();
const RTOS   = scripting.addModule("/ti/drivers/RTOS");
const Timer  = scripting.addModule("/ti/drivers/Timer", {}, false);
const Timer1 = Timer.addInstance();
const Timer2 = Timer.addInstance();
const Timer3 = Timer.addInstance();

/**
 * Write custom configuration values to the imported modules.
 */
GPIO1.$name          = "CONFIG_GPIO_0";
GPIO1.mode           = "Output";
GPIO1.outputStrength = "High";

GPIO2.$name          = "CONFIG_GPIO_1";
GPIO2.mode           = "Output";
GPIO2.outputStrength = "High";

GPIO3.$name          = "CONFIG_GPIO_2";
GPIO3.mode           = "Output";
GPIO3.outputStrength = "High";

GPIO4.$name          = "CONFIG_GPIO_3";
GPIO4.mode           = "Output";
GPIO4.outputStrength = "High";

GPIO5.$name          = "CONFIG_GPIO_4";
GPIO5.mode           = "Output";
GPIO5.outputStrength = "High";

GPIO6.$name          = "CONFIG_GPIO_5";
GPIO6.mode           = "Output";
GPIO6.outputStrength = "High";

GPIO7.$name          = "CONFIG_GPIO_6";
GPIO7.mode           = "Output";
GPIO7.outputStrength = "High";

GPIO8.$name          = "CONFIG_GPIO_7";
GPIO8.mode           = "Output";
GPIO8.outputStrength = "High";

GPIO9.$name          = "CONFIG_GPIO_8";
GPIO9.mode           = "Output";
GPIO9.outputStrength = "High";

GPIO10.$name     = "CONFIG_GPIO_BUTTON_0";
GPIO10.$hardware = system.deviceData.board.components.SW2;

GPIO11.$name     = "CONFIG_GPIO_BUTTON_1";
GPIO11.$hardware = system.deviceData.board.components.SW3;

GPIO12.$name          = "CONFIG_GPIO_LED_0";
GPIO12.$hardware      = system.deviceData.board.components.LED_RED;
GPIO12.outputStrength = "High";

GPIO13.$name                         = "CONFIG_GPIO_LED_1";
GPIO13.$hardware                     = system.deviceData.board.components.LED_YELLOW;
GPIO13.outputStrength                = "High";
GPIO13.gpioPin.$assignAllowConflicts = "boosterpack.9";

GPIO14.$name                         = "CONFIG_GPIO_LED_2";
GPIO14.$hardware                     = system.deviceData.board.components.LED_GREEN;
GPIO14.gpioPin.$assignAllowConflicts = "boosterpack.10";

PWM1.$name                              = "CONFIG_PWM_0";
PWM1.$hardware                          = system.deviceData.board.components.LED_YELLOW;
PWM1.timer.pwmPin.$assignAllowConflicts = "boosterpack.9";

PWM2.$name                              = "CONFIG_PWM_1";
PWM2.$hardware                          = system.deviceData.board.components.LED_GREEN;
PWM2.timer.pwmPin.$assignAllowConflicts = "boosterpack.10";

const Power          = scripting.addModule("/ti/drivers/Power", {}, false);
Power.parkPins.$name = "ti_drivers_power_PowerCC32XXPins0";

RTOS.name = "FreeRTOS";

Timer1.$name     = "CONFIG_TIMER_0";
Timer1.timerType = "32 Bits";

Timer2.$name     = "CONFIG_TIMER_1";
Timer2.timerType = "32 Bits";

Timer3.$name     = "CONFIG_TIMER_2";
Timer3.timerType = "32 Bits";

/**
 * Pinmux solution for unlocked pins/peripherals. This ensures that minor changes to the automatic solver in a future
 * version of the tool will not impact the pinmux you originally saw.  These lines can be completely deleted in order to
 * re-solve from scratch.
 */
GPIO1.gpioPin.$suggestSolution  = "boosterpack.4";
GPIO2.gpioPin.$suggestSolution  = "boosterpack.7";
GPIO3.gpioPin.$suggestSolution  = "boosterpack.14";
GPIO4.gpioPin.$suggestSolution  = "boosterpack.15";
GPIO5.gpioPin.$suggestSolution  = "boosterpack.18";
GPIO6.gpioPin.$suggestSolution  = "boosterpack.19";
GPIO7.gpioPin.$suggestSolution  = "boosterpack.13";
GPIO8.gpioPin.$suggestSolution  = "boosterpack.17";
GPIO9.gpioPin.$suggestSolution  = "boosterpack.30";
GPIO10.gpioPin.$suggestSolution = "boosterpack.3";
GPIO11.gpioPin.$suggestSolution = "boosterpack.11";
GPIO12.gpioPin.$suggestSolution = "boosterpack.29";
PWM1.timer.$suggestSolution     = "Timer3";
PWM2.timer.$suggestSolution     = "Timer3";
Timer1.timer.$suggestSolution   = "Timer2";
Timer2.timer.$suggestSolution   = "Timer1";
Timer3.timer.$suggestSolution   = "Timer0";
